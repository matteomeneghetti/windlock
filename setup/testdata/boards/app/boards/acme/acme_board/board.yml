## setup/testdata/boards/ws/zephyr/boards/acme/twins/board.yml
```yaml
boards:
- name: twin_a
  vendor: acme
  socs:
  - name: soc_a
- name: twin_b
  vendor: acme
  socs:
  - name: soc_b
```

## setup/testdata/boards/ws/zephyr/boards/nordic/nrf5340dk/board.yml
```yaml
# From Zephyr v4.4.2 boards/nordic/nrf5340dk/board.yml
board:
  name: nrf5340dk
  full_name: nRF5340 DK
  vendor: nordic
  socs:
  - name: 'nrf5340'
    variants:
    - name: 'ns'
      cpucluster: 'cpuapp'
```

## setup/testdata/boards/ws/zephyr/boards/qemu/cortex_m3/board.yml
```yaml
# From Zephyr v4.4.2 boards/qemu/cortex_m3/board.yml
board:
  name: qemu_cortex_m3
  full_name: QEMU Emulation for ARM Cortex-M3
  vendor: qemu
  socs:
  - name: ti_lm3s6965
```
